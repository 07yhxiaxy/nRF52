## CMakeLists.txt
```
cmake_minimum_required(VERSION 3.20.0)
find_package(Zephyr REQUIRED HINTS $ENV{ZEPHYR_BASE})
project(hello_world)
target_sources(app PRIVATE src/main.c)
# target_sources(app PRIVATE src/myfunc.c)
target_sources_ifdef(CONFIG_MYFUNC app PRIVATE src/myfunc.c)
```

## prj.conf
```kconfig
CONFIG_MYFUNC=y
```

## src/main.c
```c
#include <zephyr/kernel.h>
#include <zephyr/sys/printk.h>
#ifdef CONFIG_MYFUNC
#include "myfunc.h"
#endif

int main(void)
{
	int a = 3, b = 4;
	while(1){
		printk("Hello World!\n\r");
		printk("a is %d, b is %d, the sum is %d\n\r", a, b, sum(a,b));
		k_msleep(1000);
	}
}
```

## src/myfunc.c
```c
#include "myfunc.h"

int sum(int a, int b){
    return a+b;
}
```

## src/myfunc.h
```c
#ifndef MY_FUNCTION_H
#define MY_FUNDTION_H

int sum(int a, int b);

#endif
```
